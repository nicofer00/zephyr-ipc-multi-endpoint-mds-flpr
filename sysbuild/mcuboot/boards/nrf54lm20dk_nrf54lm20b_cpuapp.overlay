/*
 * Copyright (c) 2026 Nordic Semiconductor ASA
 *
 * SPDX-License-Identifier: Apache-2.0
 *
 * MCUboot uses the board/FLPR default RRAM layout (internal slot0/slot1).
 */

/ {
	chosen {
		zephyr,code-partition = &boot_partition;
	};
};
